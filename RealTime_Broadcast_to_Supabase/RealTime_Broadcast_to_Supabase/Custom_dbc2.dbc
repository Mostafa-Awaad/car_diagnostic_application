VERSION ""

NS_ :

BS_:

BU_:

BO_ 2024 OBD2: 8 Vector__XXX
 SG_ S01PID0D_VehicleSpeed m1 : 63|8@0+ (1,0) [0|255] "km/h" Vector__XXX
 SG_ S01PID05_EngineCoolantTemp m2 : 55|8@0+ (1,-40) [-40|215] "degC" Vector__XXX
 SG_ S01PID4D_BatterySOH m3 : 47|8@0+ (0.392156862745098, 0) [0|100] "%" Vector__XXX
 SG_ S01PID4E_BatterySOC m4 : 39|8@0+ (0.392156862745098, 0) [0|100] "%" Vector__XXX
 SG_ S01PID2F_FuelTankLevel m47 : 31|8@0+ (0.392156862745098,0) [0|100] "%" Vector__XXX
 SG_ S01PID21_DistanceMILOn m33 : 15|16@0+ (1,0) [0|65535] "km" Vector__XXX
 SG_ S01PID04_CalcEngineLoad m4 : 7|8@0+ (0.392156862745098,0) [0|100] "%" Vector__XXX
